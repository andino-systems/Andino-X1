/dts-v1/;

/ {
	compatible = "brcm,bcm2835", "brcm,bcm2708", "brcm,bcm2709";

	fragment@0 {
		target = <0xdeadbeef>;

		__overlay__ {
			brcm,pins = <0x8 0x7>;
			phandle = <0x1>;
		};
	};

	fragment@1 {
		target = <0xdeadbeef>;

		__overlay__ {
			cs-gpios = <0xdeadbeef 0x8 0x1 0xdeadbeef 0x7 0x1>;
			status = "okay";
			phandle = <0x2>;
		};
	};

	__overrides__ {
		cs0_pin = [00 00 00 01 62 72 63 6d 2c 70 69 6e 73 3a 30 00 00 00 00 02 63 73 2d 67 70 69 6f 73 3a 34 00];
		cs1_pin = <0x1 0x6272636d 0x2c70696e 0x733a3400 0x2 0x63732d67 0x70696f73 0x3a313600>;
	};

	__symbols__ {
		frag0 = "/fragment@0/__overlay__";
		frag1 = "/fragment@1/__overlay__";
	};

	__local_fixups__ {

		__overrides__ {
			cs0_pin = <0x0 0x10>;
			cs1_pin = <0x0 0x10>;
		};
	};

	__fixups__ {
		spi0_cs_pins = "/fragment@0:target:0";
		spi0 = "/fragment@1:target:0";
		gpio = "/fragment@1/__overlay__:cs-gpios:0", "/fragment@1/__overlay__:cs-gpios:12";
	};
};
