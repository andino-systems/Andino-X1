/dts-v1/;
/plugin/;

/ {
    compatible = "brcm,bcm2835", "brcm,bcm2836", "brcm,bcm2708", "brcm,bcm2709";


    fragment@1 {
        target = <&spi0>;

        frag1: __overlay__ {
            #address-cells = <1>;
            #size-cells = <0>;
            status = "okay";

            sc16is752: sc16is752@0 {
                compatible = "nxp,sc16is752";
                reg = <0>; // CE0
                clocks = <&sc16is752_clk>;
                interrupt-parent = <&gpio>; 
                interrupts = <7 0x2>; //GPIO and falling edge
                gpio-controller;
                #gpio-cells = <0>;
                spi-max-frequency = <4000000>;
                status = "okay";
                sc16is752_clk: sc16is752_clk {
                    compatible = "fixed-clock";
                    #clock-cells = <0>;
                    clock-frequency = <11059200>;
                };
            };
        };
    };

    __overrides__ {
        int_pin = <&sc16is752>,"interrupts:0";
    };
};

